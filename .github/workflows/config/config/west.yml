## .github/workflows/config/config/west.yml
```yaml
manifest:
  projects:
    - name: zmk
      url: https://github.com/zmkfirmware/zmk
      revision: main
      import: west.yml
  self:
    path: config
```
